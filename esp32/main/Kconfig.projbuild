## esp32/main/Kconfig.projbuild
```kconfig
menu "ucvm Configuration"

    menu "Architecture Support"

        config UCVM_ENABLE_AVR
            bool "Enable AVR emulation"
            default y
            help
                Include AVR (ATMega328P, ATtiny85) emulation support.

        config UCVM_ENABLE_MCS51
            bool "Enable 8051 (MCS-51) emulation"
            default y
            help
                Include 8051 (AT89S52) emulation support.

        choice UCVM_DEFAULT_ARCH
            prompt "Default architecture"
            default UCVM_DEFAULT_AVR
            help
                Architecture to use on first boot (before NVS config).

            config UCVM_DEFAULT_AVR
                bool "AVR"
                depends on UCVM_ENABLE_AVR

            config UCVM_DEFAULT_MCS51
                bool "8051 (MCS-51)"
                depends on UCVM_ENABLE_MCS51
        endchoice

    endmenu

    config UCVM_WIFI_SSID
        string "WiFi SSID"
        default "D-Link_DIR-615"
        help
            SSID of the WiFi network to connect to.

    config UCVM_WIFI_PASS
        string "WiFi Password"
        default "local1234"
        help
            Password for the WiFi network.

    config UCVM_GDB_ENABLE
        bool "Enable GDB stub over WiFi"
        default y
        help
            Enable the GDB RSP stub over TCP. Allows remote debugging
            of the emulated MCU.

    config UCVM_GDB_PORT
        int "GDB TCP port"
        depends on UCVM_GDB_ENABLE
        default 1234
        range 1024 65535
        help
            TCP port for the GDB remote serial protocol stub.

endmenu
```

## esp32/sdkconfig.defaults
```kconfig
# ucvm ESP32 defaults

# CPU
CONFIG_ESP_DEFAULT_CPU_FREQ_MHZ_240=y

# Flash
CONFIG_ESPTOOLPY_FLASHSIZE_4MB=y

# Partition table
CONFIG_PARTITION_TABLE_CUSTOM=y
CONFIG_PARTITION_TABLE_CUSTOM_FILENAME="partitions.csv"

# FreeRTOS
CONFIG_FREERTOS_HZ=1000

# Task watchdog: don't watch CPU1 IDLE — core 1 is dedicated to the emu task
CONFIG_ESP_TASK_WDT_CHECK_IDLE_TASK_CPU1=n

# WiFi
CONFIG_ESP_WIFI_SSID="ucvm"
CONFIG_ESP_WIFI_PASSWORD="ucvm1234"

# HTTP server
CONFIG_HTTPD_MAX_REQ_HDR_LEN=1024
CONFIG_HTTPD_MAX_URI_LEN=512

# LWIP
CONFIG_LWIP_LOCAL_HOSTNAME="ucvm"

# ucvm WiFi config
CONFIG_UCVM_WIFI_SSID="D-Link_DIR-615"
CONFIG_UCVM_WIFI_PASS="local1234"

# GDB stub
CONFIG_UCVM_GDB_ENABLE=y
CONFIG_UCVM_GDB_PORT=1234
```
